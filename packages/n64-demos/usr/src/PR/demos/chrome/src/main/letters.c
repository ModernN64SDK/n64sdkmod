
/**************************************************************************
 *                                                                        *
 *               Copyright (C) 1995, Silicon Graphics, Inc.               *
 *                                                                        *
 *  These coded instructions, statements, and computer programs  contain  *
 *  unpublished  proprietary  information of Silicon Graphics, Inc., and  *
 *  are protected by Federal copyright  law.  They  may not be disclosed  *
 *  to  third  parties  or copied or duplicated in any form, in whole or  *
 *  in part, without the prior written consent of Silicon Graphics, Inc.  *
 *                                                                        *
 *************************************************************************/

/*---------------------------------------------------------------------*
        Copyright (C) 1997,1998 Nintendo. (Originated by SGI)
        
        $RCSfile: letters.c,v $
        $Revision: 1.26 $
        $Date: 1999/01/13 01:40:01 $
 *---------------------------------------------------------------------*/

/*
 * File:	letters.c
 * Creator:	hsa@sgi.com
 * Create Date:	Sun Jun  4 18:40:31 PDT 1995
 *
 * VERY simple app, draws spinning letters, demonstrating simple 
 * reflection mapping techniques.
 *
 */

#define DTHETA (2.0)

#include <ultra64.h>
#include <PR/ramrom.h>	/* needed for argument passing into the app */

#include "letters.h"

/*
 * Symbol genererated by "makerom" to indicate the end of the code segment
 * in virtual (and physical) memory
 */
extern char _codeSegmentBssEnd[];

/*
 * Symbols generated by "makerom" to tell us where the static segment is
 * in ROM.
 */
extern char _staticSegmentRomStart[], _staticSegmentRomEnd[];

/*
 * Stacks for the threads as well as message queues for synchronization
 */
u64	bootStack[STACKSIZE/sizeof(u64)];

static void	idle(void *);
static void	mainproc(void *);

static OSThread	idleThread;
static u64	idleThreadStack[STACKSIZE/sizeof(u64)];

static OSThread	mainThread;
static u64	mainThreadStack[STACKSIZE/sizeof(u64)];

/* this number (the depth of the message queue) needs to be equal
 * to the maximum number of possible overlapping PI requests.
 * For this app, 1 or 2 is probably plenty, other apps might
 * require a lot more.
 */
#define NUM_PI_MSGS     8
    
static OSMesg PiMessages[NUM_PI_MSGS];
static OSMesgQueue PiMessageQ;

OSMesgQueue	dmaMessageQ, rdpMessageQ, retraceMessageQ;
OSMesg		dmaMessageBuf, rdpMessageBuf, retraceMessageBuf;
OSMesg		dummyMessage;
OSIoMesg	dmaIOMessageBuf;

/*
 * Dynamic segment in code space. Needs OS_K0_TO_PHYSICAL()...
 */
Dynamic dynamic;

/*
 * must be in BSS, not on the stack for this to work:
 */
OSTask	tlist =
{
    M_GFXTASK,			/* task type */
    OS_TASK_DP_WAIT,		/* task flags */
    NULL,			/* boot ucode pointer (fill in later) */
    0,				/* boot ucode size (fill in later) */
    NULL,			/* task ucode pointer (fill in later) */
    SP_UCODE_SIZE,		/* task ucode size */
    NULL,			/* task ucode data pointer (fill in later) */
    SP_UCODE_DATA_SIZE,		/* task ucode data size */
    &dram_stack[0],		/* task dram stack pointer */
    SP_DRAM_STACK_SIZE8,	/* task dram stack size */
    &rdp_output[0],		/* task fifo buffer ptr start */
    &rdp_output[0]+RDP_OUTPUT_LEN, /* task fifo buffer ptr end */
    NULL,			/* task data pointer (fill in later) */
    0,				/* task data size (fill in later) */
    NULL,			/* task yield buffer ptr (not used here) */
    0				/* task yield buffer size (not used here) */
};

Gfx		*glistp;	/* global for test case procs */

/*
 * global variables for arguments, to control test cases
 */
static int	rdp_flag = 1;	/* 0:xbus , 1:fifo */
static int      draw_buffer = 0;
static int	use_chrome1D = 0;
static void	*cfb_ptrs[2];
static float	theta = 0.0;
static u64	ramrombuf[RAMROM_MSG_SIZE/sizeof(u64)];
    
static void	draw_letters(Dynamic *);
static void	draw_centerpiece(Dynamic *);
static void	draw_floor(Dynamic *);
static void	draw_shadow(Dynamic *);
static void	draw_setting(Dynamic *);
static void	draw_background(Dynamic *);

float	shadowScaleX = 5.1;
float	shadowScaleZ = 2.7;
float	shadowTranslateX = -22.0;
float	shadowTranslateZ =  50.0;

/*
float	shadowScaleX = 2.7;
float	shadowScaleZ = 2.7;
float	shadowTranslateX = -40.0;
float	shadowTranslateZ =  50.0;
*/

OSPiHandle	*handler;

int
boot(void)
{
    /* notice that you can't call osSyncPrintf() until you set
     * up an idle thread.
     */
    
    osInitialize();

    handler = osCartRomInit();

    osCreateThread(&idleThread, 1, idle, (void *)0,
		   idleThreadStack+STACKSIZE/sizeof(u64), 10);
    osStartThread(&idleThread);

    /* never reached */
}

static void
idle(void *arg)
{
    /* Initialize video */
    osCreateViManager(OS_PRIORITY_VIMGR);
    osViSetMode(&osViModeTable[OS_VI_NTSC_LAN1]);
    
    /*
     * Start PI Mgr for access to cartridge
     */
    osCreatePiManager((OSPri)OS_PRIORITY_PIMGR, &PiMessageQ, PiMessages, 
		      NUM_PI_MSGS);
    
    /*
     * Create main thread
     */
    osCreateThread(&mainThread, 3, mainproc, arg,
		   mainThreadStack+STACKSIZE/sizeof(u64), 10);
    osStartThread(&mainThread);

    /*
     * Become the idle thread
     */
    osSetThreadPri( 0, 0 );
    for(;;);
}

/*
 * This is the main routine of the app.
 */
static void
mainproc(void *arg)
{
#ifdef DEBUG
    int *pr;
    char *ap;
    u32 *argp;
    u32 argbuf[16];
#endif
    int		keep_going = 1, i, j;
    OSTask	*tlistp;
    Dynamic	*dynamicp;
    char	*staticSegment;
    u32		clearcolor;

    int iter;

#ifdef DEBUG
    argp = (u32 *)RAMROM_APP_WRITE_ADDR;
    for (i=0; i<sizeof(argbuf)/4; i++, argp++) {
	osEPiReadIo(handler, (u32)argp, &argbuf[i]); /* Assume no DMA */
    }
    /* Parse the options */
    ap = (char *)argbuf;
    while (*ap != '\0') {
	while (*ap == ' ')
	    ap++;
	if ( *ap == '-' && *(ap+1) == 'r') {
	    rdp_flag = 0;
	    ap += 2;
	} else if ( *ap == '-' && *(ap+1) == '1') {
	    use_chrome1D = 1;
	    ap += 2;
	} else if ( *ap == '-' && *(ap+1) == '2') {
	    use_chrome1D = 0;
	    ap += 2;
	}
	else ap++;
    }
#endif

    cfb_ptrs[0] = &(cfb_16_a[0]);
    cfb_ptrs[1] = &(cfb_16_b[0]);

    /*
     * Setup the message queues
     */
    osCreateMesgQueue(&dmaMessageQ, &dmaMessageBuf, 1);
    
    osCreateMesgQueue(&rdpMessageQ, &rdpMessageBuf, 1);
    osSetEventMesg(OS_EVENT_DP, &rdpMessageQ, dummyMessage);
    
    osCreateMesgQueue(&retraceMessageQ, &retraceMessageBuf, 1);
    osViSetEvent(&retraceMessageQ, dummyMessage, 1);
    osViSetSpecialFeatures(OS_VI_DITHER_FILTER_ON);
    
    /*
     * Stick the static segment right after the code/data segment
     */
    staticSegment = _codeSegmentBssEnd;

    dmaIOMessageBuf.hdr.pri      = OS_MESG_PRI_NORMAL;
    dmaIOMessageBuf.hdr.retQueue = &dmaMessageQ;
    dmaIOMessageBuf.dramAddr     = staticSegment;
    dmaIOMessageBuf.devAddr      = (u32)_staticSegmentRomStart;
    dmaIOMessageBuf.size         = _staticSegmentRomEnd-_staticSegmentRomStart;

    osEPiStartDma(handler, &dmaIOMessageBuf, OS_READ);
    
    /*
     * Wait for DMA to finish
     */
    (void)osRecvMesg(&dmaMessageQ, &dummyMessage, OS_MESG_BLOCK);
    
    /*
     * Main game loop
     */
    while (keep_going) {
	
	/*
	 * pointers to build the display list.
	 */
	tlistp = &tlist;
	dynamicp = &dynamic;
	glistp = &(dynamicp->glist[0]);
	
	/*
	 * Tell RCP where each segment is
	 */
	gSPSegment(glistp++, 0, 0x0);	/* K0 (physical) address segment */
	gSPSegment(glistp++, STATIC_SEGMENT,
		   osVirtualToPhysical(staticSegment));
	
	gSPDisplayList(glistp++, rdpinit_dl);
	gSPDisplayList(glistp++, rspinit_dl);
	gDPSetDepthImage(glistp++, OS_K0_TO_PHYSICAL(zbuffer));
	
	/*
	 * clear z, z = max z, dz = 0
	 */
	gDPSetCycleType(glistp++, G_CYC_FILL);
	gDPSetColorImage(glistp++, G_IM_FMT_RGBA, G_IM_SIZ_16b, SCREEN_WD,
			 OS_K0_TO_PHYSICAL(zbuffer));
	gDPSetFillColor(glistp++, 
			GPACK_ZDZ(G_MAXFBZ,0) << 16 | GPACK_ZDZ(G_MAXFBZ,0));
	gDPFillRectangle(glistp++, 0, 0, SCREEN_WD-1, SCREEN_HT-1);
	
	
	/*
	 * Clear framebuffer
	 * doing this as a static display list is a little messier, due
	 * to cfb pointer conversion...
	 */
	gDPPipeSync(glistp++);
	gDPSetCycleType(glistp++, G_CYC_FILL);
	/*
	 * clear color, cvg = FULL or 1
	 */
	gDPSetColorImage(glistp++, G_IM_FMT_RGBA, G_IM_SIZ_16b, SCREEN_WD, 
			 OS_K0_TO_PHYSICAL(cfb_ptrs[draw_buffer]));
	clearcolor = ((GPACK_RGBA5551(64, 64, 255, 1) << 16) |
		      (GPACK_RGBA5551(64, 64, 255, 1)));
	gDPSetFillColor(glistp++, clearcolor);
	gDPFillRectangle(glistp++, 0, 0, SCREEN_WD-1, SCREEN_HT-1);
	gDPPipeSync(glistp++);
	gDPSetCycleType(glistp++, G_CYC_1CYCLE);
	
	/* end of standard display list part. */
	
	if (use_chrome1D) {
	    draw_setting(dynamicp);
	} else {
	    draw_background(dynamicp);
	    /* hack, re-init things after sprite background */
	    gSPDisplayList(glistp++, rdpinit_dl);
	    gSPDisplayList(glistp++, rspinit_dl);
	}
	draw_centerpiece(dynamicp);

	/* all done with this frame. */
	gDPFullSync(glistp++);
	gSPEndDisplayList(glistp++);
	
	
	/* 
	 * Build graphics task:
	 *
	 */
	tlistp->t.ucode_boot = (u64 *) rspbootTextStart;
	tlistp->t.ucode_boot_size = ((int)rspbootTextEnd - 
				     (int)rspbootTextStart);

	/*
	 * choose which ucode to run:
	 */
	if (rdp_flag) {
	    /* RSP output over FIFO to RDP: */
		tlistp->t.ucode = (u64 *) gspF3DEX2_fifoTextStart;
		tlistp->t.ucode_data = (u64 *) gspF3DEX2_fifoDataStart; 
	} else {
	    /* RSP output over XBUS to RDP: */
		tlistp->t.ucode = (u64 *) gspF3DEX2_xbusTextStart;
		tlistp->t.ucode_data = (u64 *) gspF3DEX2_xbusDataStart;
	}
	
	/* initial display list: */
	tlistp->t.data_ptr = (u64 *) dynamicp->glist;
	tlistp->t.data_size = ((int)(glistp - dynamicp->glist) *
			       sizeof (Gfx));

	/*
	 * Can just flush 16KB and forget about each individual pieces
	 * of data to flush.
	 */
	osWritebackDCacheAll();
	
	/* unwrap this macro for debugging:
	 *
	 *	osSpTaskStart(tlistp);
	 * becomes:
	 *	osSpTaskLoad(tlistp);
	 *	osSpTaskStartGo(tlistp);
	 */
	osSpTaskStart(tlistp);
	
	(void)osRecvMesg(&rdpMessageQ, &dummyMessage, OS_MESG_BLOCK);

	/* setup to swap buffers */
	osViSwapBuffer(cfb_ptrs[draw_buffer]);

	/* Make sure there isn't an old retrace in queue 
	 * (assumes queue has a depth of 1) 
	 */
	if (MQ_IS_FULL(&retraceMessageQ))
	    (void)osRecvMesg(&retraceMessageQ, &dummyMessage, OS_MESG_BLOCK);
	
	/* Wait for Vertical retrace to finish swap buffers */
	(void)osRecvMesg(&retraceMessageQ, &dummyMessage, OS_MESG_BLOCK);
	draw_buffer ^= 1;

	theta += DTHETA;
    }

    for(;;);
}


/* draw the spinning letters */
static void
draw_centerpiece(Dynamic *dynamicp)
{
    u16		perspNorm;
	
    guPerspective(&dynamicp->projection, &perspNorm,
		      33, 320.0/240.0, 100, 2000, 1.0);
    guLookAtReflect(&dynamicp->viewing, &(dynamicp->lookat[0]),
		       50, 0, 400,
		       0, 0, 0,
		       0, 1, 0);
	
    gSPLookAt(glistp++, &(dynamicp->lookat[0]));
    gSPPerspNormalize(glistp++, perspNorm);
    gSPMatrix(glistp++, OS_K0_TO_PHYSICAL(&(dynamicp->projection)),
		  G_MTX_PROJECTION|G_MTX_LOAD|G_MTX_NOPUSH);
    gSPMatrix(glistp++, OS_K0_TO_PHYSICAL(&(dynamicp->viewing)),
		  G_MTX_PROJECTION|G_MTX_MUL|G_MTX_NOPUSH);
	
    guTranslate(&dynamicp->letters_trans, -5.0, -7.0, 0.0);
    guScale(&dynamicp->letters_scale, 2.5, 2.5, 2.5);
    guRotate(&dynamicp->letters_rotate, theta, 0.2, 1.0, 0.0);
    gSPMatrix(glistp++, OS_K0_TO_PHYSICAL(&(dynamicp->letters_trans)),
	      G_MTX_MODELVIEW|G_MTX_LOAD|G_MTX_NOPUSH);
    gSPMatrix(glistp++, OS_K0_TO_PHYSICAL(&(dynamicp->letters_scale)),
	      G_MTX_MODELVIEW|G_MTX_MUL|G_MTX_NOPUSH);
    gSPMatrix(glistp++, OS_K0_TO_PHYSICAL(&(dynamicp->letters_rotate)),
	      G_MTX_MODELVIEW|G_MTX_MUL|G_MTX_NOPUSH);
    gSPDisplayList(glistp++, letters_setup_dl);

    if (use_chrome1D) {
	gSPDisplayList(glistp++, u64_chrome1D_dl);
    } else {
	gSPDisplayList(glistp++, u64_chrome2D_dl);
    }

    gSPDisplayList(glistp++, u64_geom_dl);

}

/* draw background for 1D chrome demo */
static void
draw_setting(Dynamic *dynamicp)
{
    u16   perspNorm;

    guPerspective(&dynamicp->projectionBG,&perspNorm,
    	      33, 1, 10, 5000, 1.0);

    gSPPerspNormalize(glistp++, perspNorm);

    guLookAt (&dynamicp->viewingBG, 0, 0, 54, 0, 0, 0, 0, 1, 0);

    guRotate (&dynamicp->identity, 0.0, 1.0, 0.0, 0.0);

    gSPMatrix(glistp++, OS_K0_TO_PHYSICAL(&(dynamicp->projectionBG)),
	  G_MTX_PROJECTION|G_MTX_LOAD|G_MTX_NOPUSH);
    gSPMatrix(glistp++, OS_K0_TO_PHYSICAL(&(dynamicp->viewingBG)),
	  G_MTX_PROJECTION|G_MTX_MUL|G_MTX_NOPUSH);
    gSPMatrix(glistp++, OS_K0_TO_PHYSICAL(&(dynamicp->identity)),
    	G_MTX_MODELVIEW|G_MTX_LOAD|G_MTX_NOPUSH);

    gSPDisplayList(glistp++, setting_setup_dl);

    gSPDisplayList(glistp++, setting_geom_dl);

}



/* draw background for 2D chrome demo */
static void
do_bkg( Gfx **pglistp )
{
    Gfx *gp, *dl;
    extern Sprite gameday_sprite;

    gp = *pglistp;

    gameday_sprite.rsp_dl_next   = gameday_sprite.rsp_dl;

    spMove( &gameday_sprite, 0,0 );
    spScale( &gameday_sprite, 1.0, 1.0 );
    spSetAttribute( &gameday_sprite, SP_FASTCOPY );

    dl = spDraw( &gameday_sprite );

    gSPDisplayList(gp++, dl );

    *pglistp = gp;
}


static void
draw_background(Dynamic *dynamicp)
{
    spInit(&glistp);	/* Initialize Sprites */

    do_bkg(&glistp);

/*
 * doesn't quite work...
    spFinish(&glistp);
*/
}


#include "sp_gameday.h"
